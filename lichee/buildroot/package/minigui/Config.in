## lichee/buildroot/package/minigui/Config.in
```kconfig
config BR2_PACKAGE_MINIGUI
	bool "minigui"
	select BR2_PACKAGE_FREETYPE
	select BR2_PACKAGE_JPEG
	select BR2_PACKAGE_LIBPNG
	help
	  minigui
```

## lichee/linux-3.4/drivers/input/touchscreen/zt2003/Kconfig
```kconfig
#
#  Touchscreen tu_ts driver configuration
#

config TOUCHSCREEN_ZT2003
       tristate  "zt2003 touchscreen driver"
       default m
       depends on INPUT && I2C
       help
         zt2003 touchscreen driver
```

## lichee/linux-3.4/drivers/media/video/sunxi-vfe/Kconfig
```kconfig
config CSI_VFE
	tristate "v4l2 driver for SUNXI"
	default m
	select VIDEOBUF_DMA_CONTIG
		
if ARCH_SUN8IW8

menu "Sensor CSI"
config OV2710_MIPI
	tristate "ov2710_mipi"
	default n
config OV4689
	tristate "ov4689"
	default n
config OV4689_60FPS
	tristate "ov4689 60fps"
	default n
config AR0330_MIPI
	tristate "ar0330 mipi"
	default n
config OV4689_SDV
	tristate "ov4689 sdv"
	default n
config GC1004_MIPI
	tristate "gc1004_mipi"
	default n
config H22_MIPI
	tristate "h22_mipi"
	default n
config NT99231_MIPI
	tristate "nt99231_mipi"
	default n	
config IMX291_MIPI
	tristate "imx291_mipi"
	default n		
config F22_MIPI
    tristate "F22_mipi"
	default n
config OV8865_4LANE 
	tristate "OV8865 4-lane"
	default n
config TP2825
	tristate "tp2825"
	default n
config TP2825_VD1_BYTE_SWAP
	bool "tp2825 vd1[0:7] byte swap"
	depends on TP2825
	default n
endmenu

endif
```

## lichee/linux-3.4/drivers/misc/hyperion/Kconfig
```kconfig
menuconfig HYPERION_HACK
	tristate "Hyperion Tech Support Driver"
	default n
	help
	  "Enable/disable and config Hyperion Tech Support Driver"

if HYPERION_HACK

config SUNXI_NAND
	tristate "Allwinner NAND driver module"
	default n
	help
	  Provides Allwinner NAND driver.

config HT_INPUT
	tristate "Platform spicific input module"
	depends on INPUT
	default m
	help
	  Provides input device enumeration for Hyperion Tech boards.

config HT_RFKILL
	tristate "Platform spicific rfkill module"
	depends on RFKILL
	default m
	help
	  Provides custom rfkill device implementation for Hyperion Tech boards.

config HT_PLATDEV
	tristate "Platform Device registration module"
	default m
	help
	  Provides customized platform device enumeration.

config HT_GPIO_KEYS
	bool "Hyperion Tech GPIO key/switch input device"
	default y if KEYBOARD_GPIO
	help
		This enables GPIO key/switch devices for Hyperion Tech boards.

config HT_GPIO_LEDS
	bool "Hyperion Tech GPIO LED device"
	default y if LEDS_GPIO
	help
		This enables GPIO LED devices for Hyperion Tech boards.

config HT_BACKLIGHT
	tristate "Backlight support"
	depends on HT_PLATDEV && BACKLIGHT_CLASS_DEVICE
	help
	  Provide platform specific backlight implementation.

config HT_RTC_S35390A
	bool "Hyperion Tech S35390A RTC device"
	default n
	help
		This enables S35390A RTC platform data for Hyperion Tech boards.

config HT_SENSOR
	bool "Hyperion Tech sensor devices"
	default y
	help
		This enables sensor devices for Hyperion Tech boards.

config HT_BMA250
	bool "Hyperion Tech BMA250 device"
	depends on HT_SENSOR && SENSORS_BMA250
	default n
	help
		This enables BMA250 platform configuration for Hyperion Tech boards.

config HT_INV_MPU9250
	bool "Hyperion Tech MPU9250 device"
	depends on HT_SENSOR && INV_MPU_IIO
	default n
	help
		This enables MPU9250 platform configuration for Hyperion Tech boards.

config HT_STMVL6180
	bool "Hyperion Tech STM VL6180 device"
	depends on HT_SENSOR && STMVL6180
	default n
	help
		This enables STM VL6180 platform configuration for Hyperion Tech boards.

config HT_MT66XX
	bool "MetiaTek MT66XX support"
	depends on HT_PLATDEV && MTK_COMBO_MT66XX
	help
	  Provide mt66xx platform device implementation.

config HT_XRADIO
	bool "XRADIO support"
	depends on HT_PLATDEV && XRADIO
	help
	  Provide XRADIO platform device implementation.

endif
```

## lichee/linux-3.4/fs/offs/Kconfig
```kconfig
config OFFS_FS
	tristate "OFFS for mmc support"
    default m
	help
	  OFFS mmc support

	  If you want to compile it in module, select m.
```
